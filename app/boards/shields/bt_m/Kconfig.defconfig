## app/boards/shields/bt_m/Kconfig.defconfig
```kconfig
# Copyright (c) 2020 The ZMK Contributors
# SPDX-License-Identifier: MIT

if SHIELD_BT_M

config ZMK_KEYBOARD_NAME
    default "IBM BT-M"

endif
```

## app/boards/shields/bt_m/Kconfig.shield
```kconfig
# Copyright (c) 2020 The ZMK Contributors
# SPDX-License-Identifier: MIT

config SHIELD_BT_M
    def_bool $(shields_list_contains,bt_m)
```
